## drivers/usb/virtual/Kconfig
```kconfig
#
# USB virtual devices
#

menuconfig VIRTUAL_USB
	   tristate "Virtual USB support"
	   help 
	   	Menu for virtual udc

if VIRTUAL_USB

 # Framework for virtual
config VIRTUAL_USB_FW
       tristate "Framework for virtual USB devices (DEVELOPMENT)"
       depends on USB=y || (USB=m && USB_GADGET=m)
       help
	Just a framework

config VIRTUAL_UDC_AND_HCD
       depends on VIRTUAL_USB_FW
       tristate "hcd and udc temporary in one"

config VIRTUAL_USB_UDC_DRV
       tristate "Virtual UDC drv"
       depends on USB=y || (USB=m && USB_GADGET=m)

config VIRTUAL_USB_UDC_REG
       tristate "Register virtual udc"
       depends on ((VIRTUAL_USB_UDC_DRV=y || VIRTUAL_USB_UDC_DRV=m))

config VIRTUAL_USB_HCD_DRV
       tristate "Virtual HCD drv"
       depends on USB=y || (USB=m && USB_GADGET=m)

config VIRTUAL_USB_HCD_REG
       tristate "Register virtual HCD"
       depends on ((VIRTUAL_USB_HCD_DRV=y || VIRTUAL_USB_HCD_DRV=m))

config VIRTUAL_USB_CONFIGFS
       tristate "Virtual USB devices configurable through ConfigFS"

endif # VIRTUAL_USB
```
